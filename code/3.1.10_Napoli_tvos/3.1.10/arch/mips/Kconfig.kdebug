## code/3.1.10_Napoli_tvos/3.1.10/drivers/blcr/Kconfig
```kconfig
#

#

menu "BLCR Support"

config BLCR_SUPPORT
    tristate "Blcr Support"
    default y if ARM
    default n
	help
	  blcr--checkpoint and restore
	  
endmenu
```

## code/3.1.10_Napoli_tvos/3.1.10/drivers/media/video/uvc_maxim/Kconfig
```kconfig
config MAXIM_USB_VIDEO_CLASS
	tristate "Maxim USB Video Class (UVC)"
	---help---
	  Support for the USB Video Class (UVC).  Currently only video
	  input devices, such as webcams, are supported.

	  For more information see: <http://linux-uvc.berlios.de/>

config MAXIM_USB_VIDEO_CLASS_INPUT_EVDEV
	bool "Maxim UVC input events device support"
	default y
	depends on MAXIM_USB_VIDEO_CLASS && INPUT
	---help---
	  This option makes USB Video Class devices register an input device
	  to report button events.

	  If you are in doubt, say Y.
```

## code/3.1.10_Napoli_tvos/mstar/arm-boards/Kconfig
```kconfig
menu "Mstar platform type"
	depends on ARCH_MSTAR

config ARCH_MSTAR_CA9X4
	bool "Mstar Cortex-A9x4 tile"
	select CPU_V7
	select ARM_GIC
	select MIGHT_HAVE_CACHE_L2X0
endmenu
```

## code/3.1.10_Napoli_tvos/mstar/arm-boards/plat-mstar/Kconfig
```kconfig
if PLAT_MSTAR

config PLAT_MSTAR_SCHED_CLOCK
	def_bool y if !ARCH_INTEGRATOR_AP
	select NEED_MACH_MEMORY_H
	select NEED_MACH_IO_H
	select HAVE_SCHED_CLOCK
endif
```

## code/3.1.10_Napoli_tvos/mstar/mstar/CPU_calibrating/Kconfig
```kconfig
config MSTAR_CPU_calibrating

bool "CPU_calibrating"

help
    MStar CPU_calibrating driver function
```

## code/3.1.10_Napoli_tvos/mstar/mstar/CPU_setting/Kconfig
```kconfig
config MSTAR_CPU_setting

bool "CPU_setting"

help
    MStar CPU_setting driver function
```

## code/3.1.10_Napoli_tvos/mstar/mstar/fusion_8_10/Kconfig
```kconfig
config MSTAR_FUSION_8_10
	tristate "Fusion(For DirectFB1.6.2 Only!)"
	---help---
	  Fusion is the IPC API used by DirectFB and FusionSound.
```

## code/3.1.10_Napoli_tvos/mstar/mstar/gflip/Kconfig
```kconfig
config MSTAR_GFLIP
tristate "GFLIP"
help
    enable MStar GFLIP driver.

if MSTAR_GFLIP

if MSTAR_TITANIA3
if MSTAR_GPIO
config MSTAR_3D_LR_REPORT
  bool "Support 3D LR Report"
  default n
  help
    Support 3D LR report
endif
endif


config MSTAR_VE_CAPTURE_SUPPORT
  bool "Support VE Capture Function"
  default y if (MSTAR_TITANIA12 || MSTAR_JANUS2 || MSTAR_AMBER5)
  default y
  help
    If Support VE Capture feature

config VERSION
  string
  option env="VERSION"

config MSTAR_NEW_FLIP_FUNCTION_ENABLE
  bool "Enable the new flip function(to replace the old one)"
  default y if (VERSION != 0 && VERSION != 1 && VERSION != 2)
  default n
  help
    If use the new function, it will make sure the flip is done in hardware vsync peroid

endif
```

## code/3.1.10_Napoli_tvos/mstar/mstar/gmac/Kconfig
```kconfig
config MSTAR_GMAC
select NET
select NET_ETHERNET
select MII
select PACKET
select USE_POLICY_FWD
select INET
select NETDEVICES

tristate "GMAC"
default n

---help---
Enable compilation option for driver GMAC

if MSTAR_GMAC
config GMAC_SUPPLY_RNG
bool "Supply to random number generator device"
default n
help
    Supply to random number generator device

config GMAC_ETHERNET_ALBANY
bool "Supply to internel PHY"
default n
help
    Supply to internel PHY

config MSTAR_GMAC_HW_TX_CHECKSUM
bool "Supply to hardware TX checksum"
default n
help
    Supply to hardware TX checksum

config MSTAR_GMAC_JUMBO_PACKET
bool "Supply to jumbo packet"
default n
help
    Supply to jumbo packet
    
config MSTAR_GMAC_RMII_DOWNGRADE_MODE
bool "Supply GMAC to use external EPHY by RMII"
default n
help
    Supply to GMAC use external RMII EPHY
endif
```

## code/3.1.10_Napoli_tvos/mstar/mstar/hw_sem/Kconfig
```kconfig
config MSTAR_HW_SEM

tristate "HW_SEMAPHORE"
  default n
  help
    MStar Hardware Semaphore driver function
```

## code/3.1.10_Napoli_tvos/mstar/mstar/ir/Kconfig
```kconfig
config MSTAR_IR

tristate "IrDA"

help
    Titania IrDA driver function

#===================================================
# FANTASY PROTOCOL
#===================================================
if MSTAR_IR

config MSTAR_IR_FANTASY_MODE
  bool "Support fantasy protocol"
  default n
  help
    Support fantasy protocol

config MSTAR_IR_INPUT_DEVICE
  bool "IR input layer device"
  default n
  select VIDEO_IR
  help
    Use MStar IR driver as input layer device like keyboard,
    This depend on VIDEO_IR and will auto enable it.

config IR_SUPPLY_RNG
bool "Supply to random number generator device"
default n
help
    Supply to random number generator device

config MSTAR_IR_MULTIPLE_MODE
  bool "Support multiple protocol"
  default n
  help
    Support multiple protocol

config MSTAR_PM_SWIR
bool "Support PM receive SWIR decode"
default n
help
    Support PM receive SWIR decode


config MSTAR_IR_POWER_KEY_LONG_PRESS
bool "Support IR Power Key Long Press for System Reset"
default n
help
    Support IR Power Key Long Press for System Reset

if MSTAR_IR_POWER_KEY_LONG_PRESS

config MSTAR_IR_POWER_KEY
hex "Set IR Power Key Value"
default 0x46
help
    Set IR Power Key Value


config MSTAR_IR_LONG_PRESS_TIMEOUT
int "Set IR Long Press Timeout Value(ms)"
default 4000
help
    Set IR Long Press Timeout Value(ms)

endif

endif
```

## code/3.1.10_Napoli_tvos/mstar/mstar/mali/Kconfig
```kconfig
menu "Mali/UMP"

choice
	prompt "Version"
	default MALI400_VERSION_NONE

config MALI400_VERSION_NONE
	bool "None"
config MALI400_VERSION_R2P3_01REL0
	bool "r2p3-01rel0"
config MALI400_VERSION_R2P4_02REL1
	bool "r2p4-02rel1"
config MALI400_VERSION_R3P1_01REL0
	bool "r3p1-01rel0"
config MALI400_VERSION_R3P1_01REL1
	bool "r3p1-01rel1"
config MALI400_VERSION_R3P2_01REL0
	bool "r3p2-01rel0"
config MALI400_VERSION_R3P2_01REL1
	bool "r3p2-01rel1"
config MALI400_VERSION_R3P2_01REL2
	bool "r3p2-01rel2"
config MALI400_VERSION_R3P2_01REL3
	bool "r3p2-01rel3"

endchoice

choice
	prompt "Platform"
	default MALI400_PLATFORM_NONE

config MALI400_PLATFORM_NONE
	bool "None"
config MALI400_PLATFORM_SUPERNOVA
	bool "Supernova"
config MALI400_PLATFORM_ANDROID_ICS
	bool "Android Ice Cream Sandwich"
config MALI400_PLATFORM_ANDROID_JELLYBEAN
	bool "Android Jelly Bean"
config MALI400_PLATFORM_ANDROID_JELLYBEAN_MR1
	bool "Android Jelly Bean MR1"
	depends on SYNC
config MALI400_PLATFORM_ANDROID_JELLYBEAN_MR2
	bool "Android Jelly Bean MR2"
	depends on SYNC

endchoice

if !(MALI400_VERSION_NONE || MALI400_PLATFORM_NONE)

config MALI400
	tristate "Mali-400/450 support"
	---help---
	  This enables support for the Mali-400, and Mali-450 GPUs.

	  To compile this driver as a module, choose M here: the module will be
	  called mali.

config MALI400_DEBUG
	bool "Enable debug in Mali driver"
	depends on MALI400
	---help---
	  This enabled extra debug checks and messages in the Mali driver.

config UMP
	tristate "UMP support"
	---help---
	  This enables support for the UMP memory allocation and sharing API.

	  To compile this driver as a module, choose M here: the module will be
	  called ump.

config UMP_DEBUG
	bool "Enable extra debug in UMP"
	depends on UMP
	---help---
	  This enabled extra debug checks and messages in UMP.

endif

endmenu
```

## code/3.1.10_Napoli_tvos/mstar/mstar/mtlb/Kconfig
```kconfig
config MSTAR_MTLB

tristate "MTLB"
	default n
	help
		Enable compilation option for driver Mstar TLB
```

## code/3.1.10_Napoli_tvos/mstar/mstar/nand/Kconfig
```kconfig
config MSTAR_NAND
  select MTD
  select MTD_CHAR
  select MTD_BLKDEVS
  select MTD_OOPS

  select MTD_COMPLEX_MAPPINGS
  select MTD_BLOCK2MTD
  select MTD_NAND_MUSEUM_IDS
  select MTD_NAND_PLATFORM
  select MTD_CMDLINE_PARTS
  select MTD_UBI
  #select MTD_UBI_WL_THRESHOLD
  #select MTD_UBI_BEB_RESERVE

  #select MTD_DEBUG
  #select MTD_DEBUG_VERBOSE
  select MTD_CONCAT
  select MTD_PARTITIONS
  select MTD_NAND
  
  tristate "NAND"
  default n

help
    Enable MSTAR FCIE NAND driver

config MTD_SLC_WRITE
	bool "MTD Write/Read SLC partition"
	depends on MSTAR_NAND	
	default n
	help   
		Support Write/Read SLC Partition
    
config MSTAR_NAND_IP
	string
	default "fcie3"
```

## code/3.1.10_Napoli_tvos/mstar/mstar/pm_addr/Kconfig
```kconfig
config MSTAR_PM_ADDR

tristate "PM_ADDR"

help
    MStar PM_ADDR driver function
```

## code/3.1.10_Napoli_tvos/mstar/mstar/points_handler/Kconfig
```kconfig
config MSTAR_POINTS_HANDLER

tristate "POINTS_HANDLER for performance index"

help
    MStar POINTS_HANDLER
default n
```

## code/3.1.10_Napoli_tvos/mstar/mstar/sata_host/Kconfig
```kconfig
config MSTAR_SATA_HOST
        tristate "SATA HOST"
        help
          MStar SATA Host driver function
    
```

## code/3.1.10_Napoli_tvos/mstar/mstar/spinand/Kconfig
```kconfig
config MSTAR_SPI_NAND
  select MTD
  select MTD_CHAR
  select MTD_BLKDEVS
  select NFTL
  select NFTL_RW
  select MTD_OOPS

  select MTD_COMPLEX_MAPPINGS
  select MTD_BLOCK2MTD
  select MTD_NAND_MUSEUM_IDS
  select MTD_NAND_PLATFORM
  select MTD_CMDLINE_PARTS
  select MTD_UBI
  #select MTD_UBI_WL_THRESHOLD
  #select MTD_UBI_BEB_RESERVE
  select SCSI_LOWLEVEL
  select AUTOFS_FS

  #select FAT_FS
  #select MSDOS_FS
  #select VFAT_FS
  #select FAT_DEFAULT_CODEPAGE
  #select FAT_DEFAULT_IOCHARSET

  #select MTD_DEBUG
  #select MTD_DEBUG_VERBOSE
  select MTD_CONCAT
  select MTD_PARTITIONS
  select MTD_NAND
  #select JFFS2_FS
  #select JFFS2_FS_DEBUG
  #select JFFS2_FS_WRITEBUFFER
  tristate "SPI NAND"
  default n
```

## code/3.1.10_Napoli_tvos/mstar/mstar/wdt/Kconfig
```kconfig
config MSTAR_WDT

tristate "Watchdog"
depends on WATCHDOG
default n 
help
    MStar Watchdog driver function
    
```

## code/3.1.10_Napoli_tvos/mstar/mstar/xzram/Kconfig
```kconfig
#menuconfig XZRAM_SUPPORT
#        tristate "XZram support"

#if XZRAM_SUPPORT


config EXT_XVMALLOC
	bool
	default n

config XZRAM
	tristate "Compressed XRAM block device with internal/external memory support"
	depends on BLOCK && SYSFS
	select EXT_XVMALLOC
	default n
	help
          Only workable at 2.6.36 or later version
	  Creates virtual block devices called /dev/xzramX (X = 0, 1, ...).
	  Pages written to these disks are compressed and stored in memory
	  itself. These disks allow very fast I/O and compression provides
	  good amounts of memory savings. You can use internal memory from
          Kernel or external from a specific physical address.

	  It has several use cases, for example: /tmp storage, use as swap
	  disks and maybe many more.

          This module is base on zram block device driver.


config XZRAM_COMPRESS_LZ4
       bool "using LZ4 algorithm"
       depends on XZRAM
       select LZ4
       default y

config XZRAM_COMPRESS_LZO
       bool "using LZO algorithm"
       depends on XZRAM
       select LZO_COMPRESS
       select LZO_DECOMPRESS
       default n

config XZRAM_COMPRESS_PERFORMANCE_STAT
       bool "Compress performance stat"
       depends on XZRAM
       default n

config  XZRAM_DEBUG
	bool "Compressed XRAM block device debug support"
	depends on XZRAM
	default n
	help
	  This option adds additional debugging code to the compressed
	  RAM block device driver.

#endif 
```
